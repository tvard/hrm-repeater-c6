## sdkconfig.defaults
```kconfig
# Enable Bluetooth (NimBLE only)
CONFIG_BT_ENABLED=y
CONFIG_BT_NIMBLE_ENABLED=y
CONFIG_BT_CONTROLLER_ENABLED=y

# NimBLE role config - enable all roles
CONFIG_BT_NIMBLE_MAX_CONNECTIONS=2
CONFIG_BT_NIMBLE_ROLE_CENTRAL=y
CONFIG_BT_NIMBLE_ROLE_PERIPHERAL=y
CONFIG_BT_NIMBLE_ROLE_BROADCASTER=y
CONFIG_BT_NIMBLE_ROLE_OBSERVER=y

# Device name
CONFIG_BT_NIMBLE_SVC_GAP_DEVICE_NAME="ESP-HRM"

# Device Information Service (DIS) — enables each characteristic
CONFIG_BT_NIMBLE_SVC_DIS_MANUFACTURER_NAME=y
CONFIG_BT_NIMBLE_SVC_DIS_MODEL_NUMBER=y
CONFIG_BT_NIMBLE_SVC_DIS_SERIAL_NUMBER=y
CONFIG_BT_NIMBLE_SVC_DIS_HARDWARE_REVISION=y
CONFIG_BT_NIMBLE_SVC_DIS_FIRMWARE_REVISION=y
CONFIG_BT_NIMBLE_SVC_DIS_SOFTWARE_REVISION=y
CONFIG_BT_NIMBLE_SVC_DIS_SYSTEM_ID=y

# Stack size
CONFIG_ESP_MAIN_TASK_STACK_SIZE=8192

# Power: run at 80MHz instead of 160MHz (BLE works fine, ~20% less power)
CONFIG_ESP_DEFAULT_CPU_FREQ_MHZ_80=y
CONFIG_ESP_DEFAULT_CPU_FREQ_MHZ=80

# Power: enable light sleep during BLE events
CONFIG_FREERTOS_USE_TICKLESS_IDLE=y
CONFIG_PM_ENABLE=y
CONFIG_BT_NIMBLE_SLEEP_ENABLE=y

# TX power: set to maximum (+20 dBm) — NimBLE-native way (no Bluedroid API needed)
# Power budget is fine: ~60mA avg on 5000mAh bank = 80+ hours; 3-4h uses <5%
CONFIG_BT_LE_PWR_LVL_P20=y
```
